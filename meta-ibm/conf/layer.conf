## meta-ibm/conf/layer.conf
```bitbake
# We have a conf and classes directory, add to BBPATH
BBPATH .= ":${LAYERDIR}"

# We have recipes-* directories, add to BBFILES
BBFILES += "${LAYERDIR}/recipes-*/*/*.bb \
            ${LAYERDIR}/recipes-*/*/*.bbappend"

BBFILE_COLLECTIONS += "ibm-layer"
BBFILE_PATTERN_ibm-layer := "^${LAYERDIR}/"
LAYERSERIES_COMPAT_ibm-layer = "hardknott honister"

BBFILES_DYNAMIC += " \
    filesystems-layer:${LAYERDIR}/dynamic-layers/filesystems-layer/recipes-*/*/*.bb \
    filesystems-layer:${LAYERDIR}/dynamic-layers/filesystems-layer/recipes-*/*/*.bbappend \
"
```
